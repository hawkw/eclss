## eclss-esp32/sdkconfig.defaults
```kconfig
# Rust often needs a bit of an extra main task stack size compared to C (the default is 3K)
CONFIG_ESP_MAIN_TASK_STACK_SIZE=20000

CONFIG_ESP_SYSTEM_EVENT_TASK_STACK_SIZE=4096

# NAPT demo (router)
CONFIG_LWIP_L2_TO_L3_COPY=y
CONFIG_LWIP_IP_FORWARD=y
CONFIG_LWIP_IPV4_NAPT=y

# Use this to set FreeRTOS kernel tick frequency to 1000 Hz (100 Hz by default).
# This allows to use 1 ms granuality for thread sleeps (10 ms by default).
#CONFIG_FREERTOS_HZ=1000

# Workaround for https://github.com/espressif/esp-idf/issues/7631
#CONFIG_MBEDTLS_CERTIFICATE_BUNDLE=n
#CONFIG_MBEDTLS_CERTIFICATE_BUNDLE_DEFAULT_FULL=n
```

## sdkconfig.defaults
```kconfig
# Rust often needs a bit of an extra main task stack size compared to C (the default is 3K)
CONFIG_ESP_MAIN_TASK_STACK_SIZE=20000

CONFIG_ESP_SYSTEM_EVENT_TASK_STACK_SIZE=4096

# Enable HTTP server websockets (necessary for web UI)
CONFIG_HTTPD_WS_SUPPORT=y

CONFIG_ESP_HTTPS_SERVER_ENABLE=y

# This is 10 by default. 16 is the maximum
CONFIG_LWIP_MAX_SOCKETS=16

# Enable the option to dispatch timer events directly from the timer ISR 
# (the executor & async timer wrapper of `esp-idf-svc` are compatible with this dispatch method)
# This has lower latency as compared to dispatching via an intermediate task
CONFIG_ESP_TIMER_SUPPORTS_ISR_DISPATCH_METHOD=y

# Enable posting to event loops directly from an ISR
# (the event loop wrapper of `esp-idf-svc` is compatible with this, including the async postbox wrapper)
CONFIG_ESP_EVENT_POST_FROM_ISR=y

# Use this to set FreeRTOS kernel tick frequency to 1000 Hz (100 Hz by default).
# This allows to use 1 ms granuality for thread sleeps (10 ms by default).
#CONFIG_FREERTOS_HZ=1000

# Workaround for https://github.com/espressif/esp-idf/issues/7631
#CONFIG_MBEDTLS_CERTIFICATE_BUNDLE=n
#CONFIG_MBEDTLS_CERTIFICATE_BUNDLE_DEFAULT_FULL=n
```
